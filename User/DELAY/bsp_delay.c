/**
 *-------------------------------------------------------------------------------
 *       (C) Copyright 2024, PSYM. All Rights Reserved
 *-------------------------------------------------------------------------------
 * @file        : bsp_delay.c
 * Description  :
 * @author      : PSYM
 *-------------------------------------------------------------------------------
 * Update note:
 * -----------   -----------   --------------------------------------------------
 *    Date         Author                              Note
 * -----------   -----------   --------------------------------------------------
 * 2024-01-07       PSYM
 *
 **/

/* ---------------------------------- 包含头文件 ---------------------------------- */
#include "bsp_delay.h"

/* ---------------------------------- 私有宏定义 ---------------------------------- */
/* None. */

/* ---------------------------------- 私有类型定义 ---------------------------------- */
/* None. */

/* ---------------------------------- 私有变量 ---------------------------------- */
static uint16_t g_fac_us = 0; /* us延时倍乘数 */

/* ---------------------------------- 扩展变量 ---------------------------------- */
/* None. */

/* ---------------------------------- 私有函数原型 ---------------------------------- */
/* None. */

/* ---------------------------------- 函数体 ---------------------------------- */

/**
 * 功能: 初始化延迟函数
 * 参数: sysclk: 系统时钟频率, 即CPU频率(HCLK)
 * 返回: None
 * 说明: None
 */
void Delay_Init(uint16_t sysclk)
{
    SysTick->CTRL = 0;                                        /* 清Systick状态，以便下一步重设，如果这里开了中断会关闭其中断 */
    HAL_SYSTICK_CLKSourceConfig(SYSTICK_CLKSOURCE_HCLK_DIV8); /* SYSTICK使用内核时钟源8分频,因systick的计数器最大值只有2^24 */

    g_fac_us = sysclk / 8; /* 不论是否使用OS, g_fac_us都需要使用,作为1us的基础时基 */
}

/**
 * 功能: 延时nus
 * 参数: nus: 要延时的us数
 * 返回: None
 * 说明: 注意: nus的值,不要大于1864135us(最大值即2^24 / g_fac_us  @g_fac_us = 9)
 */
void Delay_us(uint32_t nus)
{
    uint32_t temp;
    SysTick->LOAD = nus * g_fac_us; /* 时间加载 */
    SysTick->VAL = 0x00;            /* 清空计数器 */
    SysTick->CTRL |= 1 << 0;        /* 开始倒数 */

    do
    {
        temp = SysTick->CTRL;
    } while ((temp & 0x01) && !(temp & (1 << 16))); /* CTRL.ENABLE位必须为1, 并等待时间到达 */

    SysTick->CTRL &= ~(1 << 0); /* 关闭SYSTICK */
    SysTick->VAL = 0X00;        /* 清空计数器 */
}

/**
 * 功能: 延时nms
 * 参数: nms: 要延时的ms数 (0< nms <= 65535)
 * 返回: None
 * 说明: None
 */
void Delay_ms(uint16_t nms)
{
    uint32_t repeat = nms / 1000; /*  这里用1000,是考虑到可能有超频应用,
                                   *  比如128Mhz的时候, Delay_us最大只能延时1048576us左右了
                                   */
    uint32_t remain = nms % 1000;

    while (repeat)
    {
        Delay_us(1000 * 1000); /* 利用Delay_us 实现 1000ms 延时 */
        repeat--;
    }

    if (remain)
    {
        Delay_us(remain * 1000); /* 利用Delay_us, 把尾数延时(remain ms)给做了 */
    }
}

/**
 * 功能: HAL库内部函数用到的延时
 * 参数: Delay 要延时的毫秒数
 * 返回: None
 * 说明: HAL库的延时默认用Systick，如果我们没有开Systick的中断会导致调用这个延时后无法退出
 */
void HAL_Delay(uint32_t Delay)
{
    Delay_ms(Delay);
}
/*>>>>>>>>>> (C) COPYRIGHT PSYM <<<<<< >>>>>> END OF FILE <<<<<<<<<<*/
